#include "tft_display.h"
#include "cn_font.h"
#include <LovyanGFX.hpp>

/* ---- LovyanGFX configuration for ST7789 240x240 ---- */

class LGFX : public lgfx::LGFX_Device {
    lgfx::Panel_ST7789 _panel_instance;
    lgfx::Bus_SPI _bus_instance;
    lgfx::Light_PWM _light_instance;

public:
    LGFX(void) {
        {
            auto cfg = _bus_instance.config();
            cfg.spi_host = SPI3_HOST;
            cfg.spi_mode = 0;
            cfg.freq_write = 40000000;
            cfg.freq_read  = 16000000;
            cfg.spi_3wire  = true;
            cfg.use_lock   = true;
            cfg.dma_channel = SPI_DMA_CH_AUTO;
            cfg.pin_sclk = 21;
            cfg.pin_mosi = 47;
            cfg.pin_miso = -1;
            cfg.pin_dc   = 40;
            _bus_instance.config(cfg);
            _panel_instance.setBus(&_bus_instance);
        }
        {
            auto cfg = _panel_instance.config();
            cfg.pin_cs   = 41;
            cfg.pin_rst  = -1;
            cfg.pin_busy = -1;
            cfg.memory_width  = 240;
            cfg.memory_height = 240;
            cfg.panel_width   = 240;
            cfg.panel_height  = 240;
            cfg.offset_x = 0;
            cfg.offset_y = 0;
            cfg.offset_rotation = 0;
            cfg.dummy_read_pixel = 8;
            cfg.dummy_read_bits  = 1;
            cfg.readable    = false;
            cfg.invert      = true;
            cfg.rgb_order   = false;
            cfg.dlen_16bit  = false;
            cfg.bus_shared  = false;
            _panel_instance.config(cfg);
        }
        {
            auto cfg = _light_instance.config();
            cfg.pin_bl = 42;
            cfg.invert = false;
            cfg.freq   = 44100;
            cfg.pwm_channel = 0;
            _light_instance.config(cfg);
            _panel_instance.setLight(&_light_instance);
        }
        setPanel(&_panel_instance);
    }
};

static LGFX lcd;

/* ---- Public API ---- */

void TFT_Init(void)
{
    lcd.init();
    lcd.setRotation(0);
    lcd.fillScreen(TFT_BLACK);
    lcd.setBrightness(255);
    lcd.setSwapBytes(true);
}

void TFT_SetBacklight(uint8_t brightness)
{
    lcd.setBrightness(brightness);
}

void TFT_SetAddrWindow(uint16_t x0, uint16_t y0, uint16_t x1, uint16_t y1)
{
    lcd.setAddrWindow(x0, y0, x1 - x0 + 1, y1 - y0 + 1);
}

void TFT_FillScreen(uint16_t color)
{
    lcd.fillScreen(color);
}

void TFT_PushColors(uint16_t *colors, uint32_t count)
{
    lcd.pushPixels(colors, count);
}

/* ---- Video streaming ---- */

void TFT_StreamStart(void)
{
    lcd.startWrite();
    lcd.setAddrWindow(0, 0, 240, 240);
}

void TFT_StreamPush(uint16_t *data, uint32_t count)
{
    lcd.writePixels(data, count);
}

void TFT_StreamEnd(void)
{
    lcd.endWrite();
}

/* ---- ASCII 8x16 font data (95 chars, space ~ '~') ---- */

static const uint8_t ASCII_1608_Table[] = {
    0x00,0x00,0x00,0x00,0x00,0x00,0x00,0x00,0x00,0x00,0x00,0x00,0x00,0x00,0x00,0x00,/*" ",0*/
    0x00,0x00,0x00,0x08,0x08,0x08,0x08,0x08,0x08,0x08,0x00,0x00,0x18,0x18,0x00,0x00,/*"!",1*/
    0x00,0x48,0x6C,0x24,0x12,0x00,0x00,0x00,0x00,0x00,0x00,0x00,0x00,0x00,0x00,0x00,/*""",2*/
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    0x0C,0x32,0xC2,0x00,0x00,0x00,0x00,0x00,0x00,0x00,0x00,0x00,0x00,0x00,0x00,0x00,/*"~",94*/
};

static uint16_t g_text_fg = COLOR_WHITE;
static uint16_t g_text_bg = COLOR_BLACK;
static uint16_t g_char_buf[32 * 32];

void TFT_SetTextColor(uint16_t fg, uint16_t bg)
{
    g_text_fg = fg;
    g_text_bg = bg;
}

void TFT_DrawChar(uint16_t x, uint16_t y, char c)
{
    uint16_t i = 0;
    unsigned char idx;

    if (c < 32 || c > 126) c = ' ';
    idx = (unsigned char)(c - 32);

    for (int row = 0; row < FONT_H; row++) {
        unsigned char data = ASCII_1608_Table[idx * FONT_H + row];
        for (int col = 0; col < FONT_W; col++) {
            g_char_buf[i++] = (data & 0x01) ? g_text_fg : g_text_bg;
            data >>= 1;
        }
    }

    TFT_SetAddrWindow(x, y, x + FONT_W - 1, y + FONT_H - 1);
    TFT_PushColors(g_char_buf, FONT_W * FONT_H);
}

void TFT_DrawString(uint16_t x, uint16_t y, const char *str)
{
    while (*str && x < TFT_WIDTH) {
        if (*str == '\n') {
            x = 0;
            y += FONT_H;
            str++;
            continue;
        }
        TFT_DrawChar(x, y, *str);
        x += FONT_W;
        str++;
    }
}

void TFT_DrawChar16(uint16_t x, uint16_t y, const uint8_t *bmp)
{
    for (int row = 0; row < 16; row++) {
        for (int col = 0; col < 16; col++) {
            int byte_ofs = col * 2 + row / 8;
            int bit = row % 8;
            uint8_t on = (bmp[byte_ofs] >> bit) & 1;
            g_char_buf[row * 16 + col] = on ? g_text_fg : g_text_bg;
        }
    }
    TFT_SetAddrWindow(x, y, x + 15, y + 15);
    TFT_PushColors(g_char_buf, 256);
}

void TFT_DrawUTF8(uint16_t x0, uint16_t y0, const uint8_t *data, unsigned int len)
{
    uint16_t x = x0, y = y0;
    unsigned int pos = 0;

    while (pos < len && y + 16 <= TFT_HEIGHT) {
        uint8_t c = data[pos];
        uint32_t cp;

        /* Decode UTF-8 */
        if (c < 0x80) { cp = c; pos++; }
        else if ((c & 0xE0) == 0xC0 && pos + 1 < len) {
            cp = ((c & 0x1F) << 6) | (data[pos + 1] & 0x3F);
            pos += 2;
        }
        else if ((c & 0xF0) == 0xE0 && pos + 2 < len) {
            cp = ((c & 0x0F) << 12) | ((data[pos + 1] & 0x3F) << 6) | (data[pos + 2] & 0x3F);
            pos += 3;
        }
        else { pos++; cp = 0xFFFD; }

        if (cp == '\n') { x = x0; y += 16; continue; }
        if (cp == '\r') continue;

        if (cp < 0x80) {
            if (x + 8 > TFT_WIDTH) { x = x0; y += 16; }
            if (y + 16 > TFT_HEIGHT) break;
            TFT_DrawChar(x, y, (char)cp);
            x += 8;
        } else {
            if (x + 16 > TFT_WIDTH) { x = x0; y += 16; }
            if (y + 16 > TFT_HEIGHT) break;
            const uint8_t *bmp = cn_font_lookup((uint16_t)cp);
            if (bmp) {
                TFT_DrawChar16(x, y, bmp);
            }
            x += 16;
        }
    }
}
